## CMakeLists.txt
```
# SPDX-License-Identifier: Apache-2.0

cmake_minimum_required(VERSION 3.20.0)
find_package(Zephyr REQUIRED HINTS $ENV{ZEPHYR_BASE})
project(spotbot_central)

target_include_directories(app PRIVATE src)

# TODO: saperate this into multiple modules
target_sources(app PRIVATE
  src/modules/ble/ble.c
  src/common/common.c
  src/modules/modem/mqtt_handler.c
  src/modules/modem/network_interface.c
  src/modules/modem/esp/esp.c
  src/modules/nvm/nv_handler.c
  src/testApp/testapp.c
)

zephyr_library_include_directories(${ZEPHYR_BASE}/samples/bluetooth)
```

## prj.conf
```kconfig
#BLE config
CONFIG_BT=y
CONFIG_BT_CENTRAL=y

# for thread
CONFIG_DEBUG_THREAD_INFO=y
CONFIG_DEBUG_OPTIMIZATIONS=y

# Logger
CONFIG_LOG=y
CONFIG_LOG_BACKEND_UART=n

# ZBUS
CONFIG_ZBUS=y
CONFIG_ZBUS_LOG_LEVEL_INF=y

# non-volatile memory
CONFIG_NVS=y
CONFIG_FLASH=y
CONFIG_FLASH_PAGE_LAYOUT=y
CONFIG_NVS_LOG_LEVEL_DBG=y
CONFIG_MPU_ALLOW_FLASH_WRITE=y
```

## src/main.c
```c
/* main.c - Application main entry point */

/*
 * Copyright (c) 2015-2016 Intel Corporation
 *
 * SPDX-License-Identifier: Apache-2.0
 */

#include <errno.h>
#include <stddef.h>
#include <zephyr/bluetooth/bluetooth.h>
#include <zephyr/bluetooth/conn.h>
#include <zephyr/bluetooth/gatt.h>
#include <zephyr/bluetooth/hci.h>
#include <zephyr/bluetooth/uuid.h>
#include <zephyr/kernel.h>
#include <zephyr/sys/byteorder.h>
#include <zephyr/sys/printk.h>
#include <zephyr/types.h>


static void start_scan(void);

static struct bt_conn* default_conn;

static void device_found(const bt_addr_le_t* addr, int8_t rssi, uint8_t type,
                         struct net_buf_simple* ad)
{
    char addr_str[BT_ADDR_LE_STR_LEN];
    int err;

    if (default_conn) {
        return;
    }

    /* We're only interested in connectable events */
    if (type != BT_GAP_ADV_TYPE_ADV_SCAN_IND) {
        return;
    }

    bt_addr_le_to_str(addr, addr_str, sizeof(addr_str));
    printk("Device found: %s (RSSI %d)\n", addr_str, rssi);

    /* connect only to devices in close proximity */
    if (rssi < -50) {
        return;
    }

    if (bt_le_scan_stop()) {
        return;
    }

    err = bt_conn_le_create(addr, BT_CONN_LE_CREATE_CONN, BT_LE_CONN_PARAM_DEFAULT, &default_conn);
    if (err) {
        printk("Create conn to %s failed (%d)\n", addr_str, err);
        start_scan();
    }
}

static void start_scan(void)
{
    int err;

    /* This demo doesn't require active scan */
    err = bt_le_scan_start(BT_LE_SCAN_PASSIVE, device_found);
    if (err) {
        printk("Scanning failed to start (err %d)\n", err);
        return;
    }

    printk("Scanning successfully started\n");
}

static void connected(struct bt_conn* conn, uint8_t err)
{
    char addr[BT_ADDR_LE_STR_LEN];

    bt_addr_le_to_str(bt_conn_get_dst(conn), addr, sizeof(addr));

    if (err) {
        printk("Failed to connect to %s (%u)\n", addr, err);

        bt_conn_unref(default_conn);
        default_conn = NULL;

        start_scan();
        return;
    }

    if (conn != default_conn) {
        return;
    }

    printk("Connected: %s\n", addr);

    bt_conn_disconnect(conn, BT_HCI_ERR_REMOTE_USER_TERM_CONN);
}

static void disconnected(struct bt_conn* conn, uint8_t reason)
{
    char addr[BT_ADDR_LE_STR_LEN];

    if (conn != default_conn) {
        return;
    }

    bt_addr_le_to_str(bt_conn_get_dst(conn), addr, sizeof(addr));

    printk("Disconnected: %s (reason 0x%02x)\n", addr, reason);

    bt_conn_unref(default_conn);
    default_conn = NULL;

    start_scan();
}

BT_CONN_CB_DEFINE(conn_callbacks) = {
    .connected = connected,
    .disconnected = disconnected,
};

int main(void)
{
    int err;

    err = bt_enable(NULL);
    if (err) {
        printk("Bluetooth init failed (err %d)\n", err);
        return 0;
    }

    printk("Bluetooth initialized\n");

    start_scan();
    return 0;
}
```

## src/ble.c
```c
#include "zephyr/sys/util.h"

#include <stddef.h>
#include <stdint.h>
#include <zephyr/bluetooth/bluetooth.h>
#include <zephyr/bluetooth/conn.h>
#include <zephyr/bluetooth/gatt.h>
#include <zephyr/kernel.h>
#include <zephyr/logging/log.h>
#include <zephyr/sys/byteorder.h>
#include <zephyr/sys/printk.h>
#include <zephyr/types.h>


LOG_MODULE_REGISTER(Ble_module, LOG_LEVEL_DBG);

static void start_scan(void);

static struct bt_conn* default_conn;

#define STACKSIZE 2048
#define BLE_INT_THREAD_PRIORITY 6

// Define constants for workqueue
#define WORQ_THREAD_STACK_SIZE 512
#define WORKQ_PRIORITY 4 // Lowest priority workqueue

// Define queue structure
static K_THREAD_STACK_DEFINE(work_q_stack, WORQ_THREAD_STACK_SIZE);
static struct k_work_q tx_work_q = {0};

// Creatt Transmission_frame structure and offload function
struct Transmission_frame {
    struct k_work work;
    uint8_t data[25];
    uint8_t size;
};

static struct Transmission_frame tx_frame = {0};

static void device_found(const bt_addr_le_t* addr, int8_t rsi, uint8_t type,
                         struct net_buf_simple* ad)
{
    char addr_str[BT_ADDR_LE_STR_LEN];

    if (default_conn) {
        return;
    }

    /* We're only interested in connectable events */
    if (type != BT_GAP_ADV_TYPE_ADV_SCAN_IND) {
        return;
    }

    /* Can only connect to nordic devices */
    if (ad->len < 4) {
        return;
    }

    if (!(ad->data[2] == 0x59 && ad->data[3] == 0x00)) {
        return;
    }

    bt_addr_le_to_str(addr, addr_str, sizeof(addr_str));

    // Copy recived frame into buffer for transmission.
    tx_frame.size = ad->len;
    memcpy(tx_frame.data, ad->data, tx_frame.size);

    k_work_submit(&tx_frame.work);
    LOG_DBG("Device found: %s (RSSI %d) \n", addr_str, rsi);
    return;
}

static void start_scan(void)
{
    int err;
    struct bt_le_scan_param scan_param = {
        .type = BT_LE_SCAN_TYPE_ACTIVE,
        .options = BT_LE_SCAN_OPT_CODED,
        .interval = BT_GAP_SCAN_FAST_INTERVAL,
        .window = BT_GAP_SCAN_FAST_INTERVAL,
        .timeout = 0,
        .interval_coded = 0,
        .window_coded = 0,
    };

    /* This demo doesn't require active scan */
    err = bt_le_scan_start(&scan_param, device_found);
    if (err) {
        LOG_ERR("Scanning failed to start (err %d)\n", err);
        return;
    }

    LOG_INF("Scanning successfully started\n");
}

void offload_function(struct k_work* work_tem)
{
    struct Transmission_frame* _tx_frame = CONTAINER_OF(work_tem, struct Transmission_frame, work);
    LOG_DBG("%d", _tx_frame->size);
    LOG_HEXDUMP_DBG(_tx_frame->data, _tx_frame->size, "Data: ");

    // TODO: Put the data on channel
}

static void init_ble(int thread_id, void* unused, void* unused2)
{
    int err;
    err = bt_enable(NULL);
    if (err) {
        LOG_ERR("Bluetooth init failed (err %d)\n", err);
        return;
    }

    // Start the workqueue
    k_work_queue_init(&tx_work_q);
    k_work_queue_start(&tx_work_q, work_q_stack, K_THREAD_STACK_SIZEOF(work_q_stack),
                       WORKQ_PRIORITY, NULL);

    // Initialize work item and connect it to its handler function
    k_work_init(&tx_frame.work, offload_function);

    LOG_INF("Bluetooth initialized\n");
    start_scan();
}

K_THREAD_DEFINE(consumer, STACKSIZE, init_ble, 1, NULL, NULL, BLE_INT_THREAD_PRIORITY, 0, 0);
```
