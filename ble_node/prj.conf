## CMakeLists.txt
```
#
# Copyright (c) 2018 Nordic Semiconductor
#
# SPDX-License-Identifier: LicenseRef-Nordic-5-Clause
#
cmake_minimum_required(VERSION 3.20.0)

find_package(Zephyr REQUIRED HINTS $ENV{ZEPHYR_BASE})
project(NONE)

# NORDIC SDK APP START
target_sources(app PRIVATE
  src/main.c
  src/client.c
  src/server.c
)

target_include_directories(app PRIVATE include)

# NORDIC SDK APP END
zephyr_library_include_directories(.)
```

## sample.yaml
```
sample:
  description: Bluetooth Low Energy UART service sample
  name: BLE UART service
tests:
  sample.bluetooth.peripheral_uart:
    build_only: true
    platform_allow: nrf52dk_nrf52832 nrf52833dk_nrf52833 nrf52840dk_nrf52840
      nrf5340dk_nrf5340_cpuapp nrf5340dk_nrf5340_cpuapp_ns thingy53_nrf5340_cpuapp
      thingy53_nrf5340_cpuapp_ns nrf21540dk_nrf52840
    integration_platforms:
      - nrf52dk_nrf52832
      - nrf52833dk_nrf52833
      - nrf52840dk_nrf52840
      - nrf5340dk_nrf5340_cpuapp
      - nrf5340dk_nrf5340_cpuapp_ns
      - thingy53_nrf5340_cpuapp
      - thingy53_nrf5340_cpuapp_ns
      - nrf21540dk_nrf52840
    tags: bluetooth ci_build
  sample.bluetooth.peripheral_uart.sysbuild:
    build_only: true
    sysbuild: true
    platform_allow: nrf52840dk_nrf52840 nrf5340dk_nrf5340_cpuapp
      nrf5340dk_nrf5340_cpuapp_ns
    integration_platforms:
      - nrf52840dk_nrf52840
      - nrf5340dk_nrf5340_cpuapp
      - nrf5340dk_nrf5340_cpuapp_ns
    tags: bluetooth ci_build sysbuild
  sample.bluetooth.peripheral_uart_ble_rpc:
    build_only: true
    extra_configs:
      - CONFIG_BT_RPC_STACK=y
    integration_platforms:
      - nrf5340dk_nrf5340_cpuapp
    platform_allow: nrf5340dk_nrf5340_cpuapp
    tags: bluetooth ci_build
```

## prj.conf
```kconfig
#
# Copyright (c) 2018 Nordic Semiconductor
#
# SPDX-License-Identifier: LicenseRef-Nordic-5-Clause
#

CONFIG_HEAP_MEM_POOL_SIZE=2048

CONFIG_BT=y
CONFIG_BT_PERIPHERAL=y
CONFIG_BT_DEVICE_NAME="BLE_node"
CONFIG_BT_MAX_CONN=1
CONFIG_BT_MAX_PAIRED=1

# Enable the NUS service
CONFIG_BT_NUS=y
CONFIG_BT_BUF_ACL_RX_SIZE=251
CONFIG_BT_BUF_ACL_TX_SIZE=251
CONFIG_BT_L2CAP_TX_MTU=247
CONFIG_BT_CTLR_DATA_LENGTH_MAX=251

# Enable bonding
CONFIG_BT_SETTINGS=y
CONFIG_FLASH=y
CONFIG_FLASH_PAGE_LAYOUT=y
CONFIG_FLASH_MAP=y
CONFIG_NVS=y
CONFIG_SETTINGS=y

# Enable DK LED and Buttons library
CONFIG_GPIO=y
CONFIG_DK_LIBRARY=y

# This example requires more stack
CONFIG_MAIN_STACK_SIZE=1152
CONFIG_SYSTEM_WORKQUEUE_STACK_SIZE=2048

# Config logger
CONFIG_LOG=y
CONFIG_USE_SEGGER_RTT=y
CONFIG_LOG_BACKEND_RTT=y
CONFIG_LOG_BACKEND_UART=n
CONFIG_LOG_PRINTK=n
CONFIG_LOG_MODE_IMMEDIATE=y
CONFIG_ASSERT=y

# Other config
CONFIG_ENTROPY_GENERATOR=y
CONFIG_TIMEOUT_64BIT=y

# Enable nordic security backend and PSA APIs
CONFIG_NRF_SECURITY=y
CONFIG_MBEDTLS_PSA_CRYPTO_C=y

CONFIG_MBEDTLS_ENABLE_HEAP=y
CONFIG_MBEDTLS_HEAP_SIZE=8192

CONFIG_PSA_WANT_ALG_SHA_256=y
CONFIG_PSA_WANT_GENERATE_RANDOM=y
```

## src/main.c
```c
/** @file
 *  @brief Nordic UART Bridge Service (NUS) sample with dynamic thread for sensor
 */

#include "client.h"
#include "common.h"
#include "server.h"

#include <bluetooth/services/nus.h>
#include <dk_buttons_and_leds.h>
#include <soc.h>
#include <stdbool.h>
#include <stdint.h>
#include <stdio.h>
#include <string.h>
#include <sys/errno.h>
#include <zephyr/bluetooth/bluetooth.h>
#include <zephyr/bluetooth/gatt.h>
#include <zephyr/bluetooth/hci.h>
#include <zephyr/bluetooth/uuid.h>
#include <zephyr/device.h>
#include <zephyr/devicetree.h>
#include <zephyr/random/random.h>
#include <zephyr/settings/settings.h>
#include <zephyr/types.h>


#define STACKSIZE CONFIG_BT_NUS_THREAD_STACK_SIZE
#define PRIORITY_BLE_TRANSMIT 7

#define DEVICE_NAME CONFIG_BT_DEVICE_NAME
#define DEVICE_NAME_LEN (sizeof(DEVICE_NAME) - 1)

#define RUN_STATUS_LED DK_LED1
#define CON_STATUS_LED DK_LED2

#define RUN_LED_BLINK_INTERVAL 1000

LOG_MODULE_REGISTER(LOG_MODULE_NAME);

static K_SEM_DEFINE(ble_init_ok, 0, 1);
K_FIFO_DEFINE(fifo_tx_data);

static struct bt_conn* current_conn;
static struct bt_conn* auth_conn;
static enum state_e state = IDLE;

static const struct bt_data ad[] = {
    BT_DATA_BYTES(BT_DATA_FLAGS, (BT_LE_AD_GENERAL | BT_LE_AD_NO_BREDR)),
    BT_DATA(BT_DATA_NAME_COMPLETE, DEVICE_NAME, DEVICE_NAME_LEN),
};

static const struct bt_data sd[] = {
    BT_DATA_BYTES(BT_DATA_UUID128_ALL, BT_UUID_NUS_VAL),
};

static void connected(struct bt_conn* conn, uint8_t err)
{
    char addr[BT_ADDR_LE_STR_LEN];

    if (err) {
        LOG_ERR("Connection failed (err %u)", err);
        return;
    }

    bt_addr_le_to_str(bt_conn_get_dst(conn), addr, sizeof(addr));
    LOG_INF("Connected %s", addr);

    current_conn = bt_conn_ref(conn);

    dk_set_led_on(CON_STATUS_LED);
}

static void disconnected(struct bt_conn* conn, uint8_t reason)
{
    char addr[BT_ADDR_LE_STR_LEN];

    bt_addr_le_to_str(bt_conn_get_dst(conn), addr, sizeof(addr));

    LOG_INF("Disconnected: %s (reason %u)", addr, reason);

    if (auth_conn) {
        bt_conn_unref(auth_conn);
        auth_conn = NULL;
    }

    if (current_conn) {
        bt_conn_unref(current_conn);
        current_conn = NULL;
        dk_set_led_off(CON_STATUS_LED);
    }
}

BT_CONN_CB_DEFINE(conn_callbacks) = {
    .connected = connected,
    .disconnected = disconnected,
};

static void bt_receive_cb(struct bt_conn* conn, const uint8_t* const data, uint16_t len)
{
    char addr[BT_ADDR_LE_STR_LEN] = {0};

    bt_addr_le_to_str(bt_conn_get_dst(conn), addr, ARRAY_SIZE(addr));

    LOG_INF("Received data from: %s", addr);

    for (uint16_t pos = 0; pos != len;) {
        struct uart_data_t* tx = k_malloc(sizeof(*tx));

        if (!tx) {
            LOG_WRN("Not able to allocate UART send data buffer");
            return;
        }

        /* Keep the last byte of TX buffer for potential LF char. */
        size_t tx_data_size = sizeof(tx->data) - 1;

        if ((len - pos) > tx_data_size) {
            tx->len = tx_data_size;
        }
        else {
            tx->len = (len - pos);
        }

        memcpy(tx->data, &data[pos], tx->len);

        pos += tx->len;

        /* Append the LF character when the CR character triggered
         * transmission from the peer.
         */
        if ((pos == len) && (data[len - 1] == '\r')) {
            tx->data[tx->len] = '\n';
            tx->len++;
        }

        // TODO: add handling for named communication

        // Logic to identify and route msg to threads
        if (state == SERVER) {
            k_fifo_put(&fifo_server_response, tx);
        }
        else if (state == CLIENT) {
            k_fifo_put(&fifo_client_response, tx);
        }
        else {
            if (strncmp(tx->data, "start", 5) == 0) {
                start_generator();
            }
        }
    }
}

static struct bt_nus_cb nus_cb = {
    .received = bt_receive_cb,
};

void error(void)
{
    dk_set_leds_state(DK_ALL_LEDS_MSK, DK_NO_LEDS_MSK);

    while (true) {
        /* Spin for ever */
        k_sleep(K_MSEC(1000));
    }
}

static void configure_gpio(void)
{
    int err;

    err = dk_leds_init();
    if (err) {
        LOG_ERR("Cannot init LEDs (err: %d)", err);
    }

    err = dk_buttons_init(&button_pressed);
    if (err) {
        LOG_ERR("Cannot init LEDs (err: %d)", err);
    }
}

void reset_state()
{
    state = IDLE;
}

void request_state(enum state_e s)
{
    state = s;
}

enum state_e get_state()
{
    return state;
}

int crypto_init(void)
{
    psa_status_t status;

    /* Initialize PSA Crypto */
    status = psa_crypto_init();
    if (status != PSA_SUCCESS)
        return -1;

    return 0;
}

int main(void)
{
    int blink_status = 0;
    int err = 0;

    configure_gpio();

    err = crypto_init();
    if (err) {
        error();
    }

    err = bt_enable(NULL);
    if (err) {
        error();
    }

    LOG_INF("Bluetooth initialized");

    k_sem_give(&ble_init_ok);

    if (IS_ENABLED(CONFIG_SETTINGS)) {
        settings_load();
    }

    err = bt_nus_init(&nus_cb);
    if (err) {
        LOG_ERR("Failed to initialize UART service (err: %d)", err);
        return 0;
    }

    err = bt_le_adv_start(BT_LE_ADV_CONN, ad, ARRAY_SIZE(ad), sd, ARRAY_SIZE(sd));
    if (err) {
        LOG_ERR("Advertising failed to start (err %d)", err);
        return 0;
    }

    for (;;) {
        dk_set_led(RUN_STATUS_LED, (++blink_status) % 2);
        k_sleep(K_MSEC(RUN_LED_BLINK_INTERVAL));
    }
}

// Runnable for BLE thread which will take care of ble transmission.
void ble_write_thread(void)
{
    /* Don't go any further until BLE is initialized */
    k_sem_take(&ble_init_ok, K_FOREVER);

    for (;;) {
        /* Wait indefinitely for data to be sent over bluetooth */
        struct uart_data_t* buf = k_fifo_get(&fifo_tx_data, K_FOREVER);

        // TODO: add handling for named communication
        if (bt_nus_send(NULL, buf->data, buf->len)) {
            LOG_WRN("Failed to send data over BLE connection");
        }

        k_free(buf);
    }
}

K_THREAD_DEFINE(ble_write_thread_id, STACKSIZE, ble_write_thread, NULL, NULL, NULL,
                PRIORITY_BLE_TRANSMIT, 0, 0);
```

## include/client.h
```c
#ifndef CLIENT_THREAD_H_
#define CLIENT_THREAD_H_

#include "zephyr/toolchain.h"

#include <soc.h>
#include <stdbool.h>
#include <stdint.h>
#include <zephyr/kernel.h>
#include <zephyr/random/random.h>
#include <zephyr/types.h>


#define PRIORITY_CLIENT 8
#define GENERATOR_THREAD_STACKSIZE 1024

#define ACK_OK "ok"
#define ACK_N_OK "n_ok"

EXTERN_C struct k_fifo fifo_client_response;

void data_generator(void* arg0, void* arg1, void* agr2);
void start_generator();

#endif // CLIENT_THREAD_H_
```

## include/common.h
```c
#ifndef COMMON_THREAD_H_
#define COMMON_THREAD_H_

#include "zephyr/toolchain.h"

#include <psa/crypto.h>
#include <psa/crypto_extra.h>
#include <zephyr/kernel.h>
#include <zephyr/logging/log.h>


#define LOG_MODULE_NAME ble_node

#define RESPONSE_TIMEOUT K_MSEC(5000)
#define START_COMMAND "start"

EXTERN_C struct k_fifo fifo_tx_data;
struct uart_data_t {
    void* fifo_reserved;
    uint8_t data[CONFIG_BT_NUS_UART_BUFFER_SIZE];
    uint16_t len;
};

enum state_e { SERVER, CLIENT, IDLE };

void reset_state();
void request_state(enum state_e);
enum state_e get_state();

#endif // COMMON_THREAD_H_
```

## include/server.h
```c
#ifndef SERVER_THREAD_H_
#define SERVER_THREAD_H_

#include "server.h"
#include "zephyr/toolchain.h"

#include <zephyr/kernel.h>


#define SW0_NODE DK_BTN1_MSK

#define SERVER_THREAD_STACKSIZE 1024
#define PRIORITY_SERVER 8
#define SHA256_SIZE (32)

EXTERN_C struct k_fifo fifo_server_response;

void button_pressed(uint32_t button_state, uint32_t has_changed);

#endif // SERVER_THREAD_H_
```

## src/client.c
```c
#include "client.h"

#include "common.h"
#include "psa/crypto.h"
#include "psa/crypto_values.h"
#include "zephyr/kernel.h"

#include <stdbool.h>
#include <string.h>

LOG_MODULE_DECLARE(LOG_MODULE_NAME);
static K_SEM_DEFINE(start_command, 0, 1);
K_FIFO_DEFINE(fifo_client_response);

static uint8_t sensor_reading[5];

bool validate(struct uart_data_t* data)
{
    psa_status_t status;
    status = psa_hash_compare(PSA_ALG_SHA_256, sensor_reading, sizeof(sensor_reading), data->data,
                              data->len);
    if (status != PSA_SUCCESS) {
        LOG_INF("psa_hash_compare failed! (Error: %d)", status);
        return false;
    }
    // reset sensor data for next measurement
    memset(&sensor_reading, 0, sizeof(sensor_reading));
    k_free(data);
    return true;
}

void start_generator()
{
    k_sem_give(&start_command);
}

// Runnable for sensor thread which take care of sensor reading
void data_generator(void* arg0, void* arg1, void* agr2)
{
    bool is_valid = false;

    while (1) {
        k_sem_take(&start_command, K_FOREVER);
        request_state(CLIENT);

        psa_status_t status = psa_generate_random(sensor_reading, sizeof(sensor_reading));
        if (status != PSA_SUCCESS) {
            LOG_INF("psa_generate_random failed! (Error: %d)", status);
            reset_state();
            continue;
        }
        // memset(sensor_reading, 2, sizeof(sensor_reading)); // for testing
        LOG_HEXDUMP_INF(sensor_reading, sizeof(sensor_reading), "Sensor_reading :");

        //  Allocate memory for the UART data structure
        struct uart_data_t* buf = k_malloc(sizeof(*buf));
        if (buf) {
            // store sensor readings into buffer
            memcpy(buf->data, sensor_reading, sizeof(sensor_reading));
            buf->len = sizeof(sensor_reading);

            // Send to BLE via FIFO
            k_fifo_put(&fifo_tx_data, buf);
        }
        else {
            LOG_ERR("Failed to allocate memory for buf");
            reset_state();
            continue;
        }

        // wait for response with timeout
        struct uart_data_t* response = k_fifo_get(&fifo_client_response, RESPONSE_TIMEOUT); // temp
        if (response) {
            is_valid = validate(response);
        }
        else {
            LOG_ERR("Timeout happened");
            reset_state();
            continue;
        }

        //  Generate Ack for data received data
        struct uart_data_t* ack = k_malloc(sizeof(*ack));
        if (buf) {
            if (is_valid) {
                memcpy(ack->data, ACK_OK, sizeof(ACK_OK));
                ack->len = sizeof(ACK_OK);
            }
            else {
                memcpy(ack->data, ACK_N_OK, sizeof(ACK_N_OK));
                ack->len = sizeof(ACK_N_OK);
            }

            // Send to BLE via FIFO
            k_fifo_put(&fifo_tx_data, ack);
        }
        else {
            LOG_ERR("Failed to allocate memory for buf");
        }

        reset_state();
    }
}

K_THREAD_DEFINE(data_generator_thread, GENERATOR_THREAD_STACKSIZE, data_generator, NULL, NULL, NULL,
                PRIORITY_CLIENT, 0, 0);
```

## src/server.c
```c
#include "server.h"

#include "common.h"
#include "psa/crypto.h"
#include "psa/crypto_types.h"
#include "psa/crypto_values.h"
#include "zephyr/kernel.h"
#include "zephyr/logging/log.h"

#include <stdint.h>


LOG_MODULE_DECLARE(LOG_MODULE_NAME);
static K_SEM_DEFINE(button_state_pressed, 0, 1);
K_FIFO_DEFINE(fifo_server_response);

void button_pressed(uint32_t button_state, uint32_t has_changed)
{
    if ((button_state == 1) && (get_state() == IDLE)) {
        LOG_ERR("Button 1");
        k_sem_give(&button_state_pressed);
    }
}

void hash_response(struct uart_data_t* response)
{
    uint8_t hash[SHA256_SIZE];
    uint32_t olen;
    psa_status_t status;
    status =
        psa_hash_compute(PSA_ALG_SHA_256, response->data, response->len, hash, sizeof(hash), &olen);
    if (status != PSA_SUCCESS) {
        LOG_ERR("psa hash failed: %d", status);
        return;
    }
    LOG_HEXDUMP_INF(hash, sizeof(hash), "Hash");

    // Allocate memory to send hash
    struct uart_data_t* hash_response = k_malloc(sizeof(*hash_response));
    if (hash_response) {
        // Convert sensor reading to string and store in buf->data
        memcpy(hash_response->data, hash, sizeof(hash));
        hash_response->len = sizeof(hash);

        // Send to BLE via FIFO
        k_fifo_put(&fifo_tx_data, hash_response);
    }
    else {
        LOG_ERR("Failed to allocate memory for buf");
        reset_state();
        return;
    }

    k_free(response);
}

void button_handler(void)
{
    while (1) {
        // wait for button press
        k_sem_take(&button_state_pressed, K_FOREVER);
        request_state(SERVER);

        // Allocate memory for the UART data structure
        struct uart_data_t* request = k_malloc(sizeof(*request));
        if (request) {
            // Convert sensor reading to string and store in buf->data
            memcpy(request->data, START_COMMAND, sizeof(START_COMMAND));
            request->len = sizeof(START_COMMAND);

            // Send to BLE via FIFO
            k_fifo_put(&fifo_tx_data, request);
        }
        else {
            LOG_ERR("Failed to allocate memory for buf");
            reset_state();
            continue;
        }

        // wait for response with timeout
        struct uart_data_t* response = k_fifo_get(&fifo_server_response, RESPONSE_TIMEOUT); // temp
        if (response) {
            LOG_HEXDUMP_INF(response->data, response->len, "random Numbers");
            hash_response(response);
        }
        else {
            LOG_ERR("Timeout happened");
            reset_state();
            continue;
        }

        // Wait for ACK with timeout
        response = k_fifo_get(&fifo_server_response, RESPONSE_TIMEOUT); // temp
        if (response) {
            LOG_INF("Response %c", response->data[0]);
        }
        else {
            LOG_ERR("Timeout happened");
        }

        reset_state();
        //  Sleep for 500 ms
        k_msleep(500);
    }
}

K_THREAD_DEFINE(button_handler_thread, SERVER_THREAD_STACKSIZE, button_handler, NULL, NULL, NULL,
                PRIORITY_SERVER, 0, 0);
```
